## west.yml
```yaml
manifest:
  remotes:
    - name: zephyrproject
      url-base: https://github.com/zephyrproject-rtos

  # Please add items below based on alphabetical order.
  # These dependencies may need updating if new features are added to the firmware.
  projects:
    - name: zephyr
      west-commands: scripts/west-commands.yml
      revision: 8c49afac8d5efa5a5519d1e102c92c120441b8a5
      remote: zephyrproject
      import: true
  self:
    path: nrf52840_lpm
```
