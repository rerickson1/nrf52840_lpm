## CMakeLists.txt
```
cmake_minimum_required(VERSION 3.13.1)
include($ENV{ZEPHYR_BASE}/cmake/app/boilerplate.cmake NO_POLICY_SCOPE)
project(pinnacle100_power_mgmt)

FILE(GLOB app_sources src/*.c)
target_sources(app PRIVATE ${app_sources})
include_directories(${CMAKE_SOURCE_DIR}/include)
```

## Kconfig
```
config PINNACLE100_POWER_MGMT_EXAMPLE
	bool
	default y
	select HAS_SYS_POWER_STATE_SLEEP_1
	help
	  Hidden option enabling low power states.
	  This is needed, as these states are implemented by this example.

# Include Zephyr's Kconfig.
source "$ZEPHYR_BASE/Kconfig"
```

## prj.conf
```kconfig
# Uncomment to allow the example to work bootloader
# CONFIG_FLASH_LOAD_OFFSET=0x1000

CONFIG_UART_0_NRF_UARTE=y

CONFIG_SYS_POWER_MANAGEMENT=y
CONFIG_SYS_POWER_SLEEP_STATES=y
CONFIG_DEVICE_POWER_MANAGEMENT=y
CONFIG_DEVICE_IDLE_PM=y
CONFIG_SYS_PM_STATE_LOCK=y
CONFIG_SYS_PM_MIN_RESIDENCY_SLEEP_1=10000

# Debug
# CONFIG_NO_OPTIMIZATIONS=y
# CONFIG_DEBUG_OPTIMIZATIONS=y
# CONFIG_SEGGER_SYSTEMVIEW=y
# CONFIG_USE_SEGGER_RTT=y
# enable to use thread names
CONFIG_THREAD_NAME=y
```

## nrf52840_pca10056.overlay
```dts
&uart0 {
	compatible = "nordic,nrf-uarte";
	current-speed = <115200>;
	status = "ok";
	tx-pin = <6>;
	rx-pin = <8>;
	rts-pin = <5>;
	cts-pin = <7>;
};
```

## src/main.c
```c
#include <zephyr.h>

#define BUSY_WAIT_TIME_SECONDS 5
#define BUSY_WAIT_TIME (BUSY_WAIT_TIME_SECONDS * 1000000)
#define SLEEP_TIME_SECONDS 15

/* Application main Thread */
void main(void)
{
	printk("\n\n*** Power Management Demo on %s ***\n\n", CONFIG_BOARD);

	while (1) {
		printk("App busy waiting for %d seconds\n",
		       BUSY_WAIT_TIME_SECONDS);
		k_busy_wait(BUSY_WAIT_TIME);
		printk("App sleeping for %d seconds\n", SLEEP_TIME_SECONDS);
		k_sleep(K_SECONDS(SLEEP_TIME_SECONDS));
	}

	printk("Exiting main()\n");
	return;
}
```

## src/power.c
```c
#include <zephyr.h>
#include <power.h>
#include <device.h>
#include <uart.h>

static void shutdown_console_uart(void)
{
	struct device *uart_dev;
	uart_dev = device_get_binding(CONFIG_UART_CONSOLE_ON_DEV_NAME);

	int rc = device_set_power_state(uart_dev, DEVICE_PM_OFF_STATE, NULL,
					NULL);
	if (rc) {
		printk("Error disabling console UART peripheral (%d)\n", rc);
	}
}

static void startup_console_uart(void)
{
	struct device *uart_dev;
	uart_dev = device_get_binding(CONFIG_UART_CONSOLE_ON_DEV_NAME);
	int rc = device_set_power_state(uart_dev, DEVICE_PM_ACTIVE_STATE, NULL,
					NULL);
	if (rc) {
		printk("Error enabling console UART peripheral (%d)\n", rc);
	}
}

/*
 * Application defined function for doing any target specific operations
 * for low power entry.
 */
void sys_pm_notify_power_state_entry(enum power_states state)
{
	switch (state) {
	case SYS_POWER_STATE_SLEEP_1:
		shutdown_console_uart();
		k_cpu_idle();
		break;
	default:
		printk("Unsupported power state %u\n", state);
		break;
	}
}

/*
 * Application defined function for doing any target specific operations
 * for low power exit.
 */
void sys_pm_notify_power_state_exit(enum power_states state)
{
	switch (state) {
	case SYS_POWER_STATE_SLEEP_1:
		startup_console_uart();
		break;

	default:
		printk("Unsupported power state %u\n", state);
		break;
	}
}
```
